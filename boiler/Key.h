#ifndef _KEY_														//Защита от повторного включения файла
#define _KEY_

#include <avr/iom128.h>												//Стандартная библиотека ввода/вывода

#define UP   0														//Константа "Кнопка отпущена"
#define DOWN 1														//Константа "Кнопка нажата"
#define LATCH_ON 1													//Константа "Включить фиксацию"
#define LATCH_OFF 0													//Константа "Выключить фиксацию"

#include "Timer2.h"													//Библиотека работы с таймром 2

//============================= Функция инициализации кнопок ===============================
//Функция принимает в качестве параметров:
//key - Номер кнопки
//sw  - Признак включения фиксации нажатия кнопки (0-фиксация выключена/1-фиксация включена)
//Функция возвращает:
//0x00-если указано корректное значение признака фиксации и номер кнопки, в противном случае 0xFF

void Key_Init(char sw)
{
	DDRA&=0xF0;														//Настройка линий кнопок на вход
	PORTA|=0x0F;													//Включение подтягивающих резисторов
	
	_Latch=sw;														//Включение/выключение фиксации для заданной кнопки
	_Key_flags=0;													//Сброс флага фиксации кнопки

#ifdef TIMER2	
	if (sw==1) _Timer2_Enable();									//Инициализация и запуск таймера 2
	sei();															//Разрешить все прерывания	
#endif
}

//=========================== Функция чтения состояния кнопок ==============================
//Функция принимает в качестве параметров:
//key - Номер кнопки
//Функция возвращает:
//Состояние кнопки (0x01-кнопка нажата/0x00-кнопка не нажата)

char Key(char key)
{
	char temp;														//Вспомогательная переменная	
	
	if (_Latch==0)
	{
		switch (key)
		{
		case 0: return ((PINA & (1<<PA3)) >> PA3) ^ 0x01;
		case 1: return ((PINA & (1<<PA2)) >> PA2) ^ 0x01;
		case 2: return ((PINA & (1<<PA1)) >> PA1) ^ 0x01;
		case 3: return ((PINA & (1<<PA0)) >> PA0) ^ 0x01;		
		default: return 0xFF;
		}
	}
	else 
	{
		temp=(_Key_flags>>key) & 0x01;								//Считать флаг фиксатора
		_Key_flags&=~(0x01<<key);									//Сбросить фиксатор для данной кнопки
		return temp;
	}
}
#endif
