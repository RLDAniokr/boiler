/*
 * interrupts_boiler.h
 *
 * Created: 13.03.2018
 * Author: Antipin
 * Обработка программных прерываний
*/

#ifndef __interrupts_boiler
#define __interrupts_boiler

//==============Функция инициализации таймера=================//
void Timer0_Init(void)
{
	// Установка делителя таймера 0 в 1024
	TCCR0 |= (1<<CS00)|(1<<CS01)|(1<<CS02);
	TCNT0 = 111;
	// Разрешить прерывание по переполнению таймера счетчика
	TIMSK |= (1<<TOIE0);
	// Выставить бит общего разрешения прерываний
	sei();
}

//============ Обработчик прерывания по таймеру 0=============//
ISR(TIMER0_OVF_vect)
{
	//Установка следующего прерывания через 10 мс
	TCNT0 = 111;
	
	//Обнуление таймера периода ШИМ-управления
	if (time_10_shim >= (uint32_t)per_shim_RAM*100) time_10_shim = 0;
	
	//Флаг функции переключения насоса
	if (flag_P == 1)
	{
		//Время переключения насоса еще не вышло
		if (time_10_nas >= 0 && time_10_nas < (uint32_t)time_per_nas*100)
		{
			//Выключение насоса
			PORTD &= ~(1<<PD4);
			if (vis[4] == '1')
			{
				vis[4]='0';
				flag_O = 1;
			}
			//Инкремент таймера насоса
			time_10_nas++;
		}
		//Время переключения насоса истекло
		else if (time_10_nas >= (uint32_t)time_per_nas*100)
		{
			//Обнуление таймера насоса
			time_10_nas = 0;
			//Обнуление флага переключения насоса
			flag_P = 0;
		}
	}
	
	//Инкрементация счетчика таймера чтения датчиков
	if (time_10_clock<=100) time_10_clock++;
	//Защита от переполнения таймера чтения датчиков
	else time_10_clock=0;
	
	//Инкрементация счетчика таймера чтения датчиков
	if (time_10_dat<=999900) time_10_dat++;
	//Защита от переполнения таймера чтения датчиков
	else time_10_dat=0;
	
	//Инкрементация счетчика таймера периода ШИМ-управления
	if (time_10_shim<=999900) time_10_shim++;
	//Защита от переполнения таймера периода ШИМ-управления
	else time_10_shim=0;
	
	// Инкрементация счетчика "прокручивания" показаний датчиков на экране
	if (time_10_slide<600) time_10_slide++;
	else time_10_slide=0;

	//Вызов функции чтения датчиков
	read_sencors();
}

#endif